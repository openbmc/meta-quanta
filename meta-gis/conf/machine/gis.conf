## meta-gis/conf/machine/gis.conf
```bitbake
KMACHINE = "nuvoton"
KERNEL_DEVICETREE = "${KMACHINE}-npcm730-gis.dtb"

UBOOT_MACHINE = "PolegSVB_config"
IGPS_MACHINE = "GIS"

FLASH_SIZE = "65536"
require conf/machine/include/npcm7xx.inc
require conf/machine/include/obmc-bsp-common.inc

IMAGE_FSTYPES += " cpio.${INITRAMFS_CTYPE}.u-boot"
IMAGE_FSTYPES += " mtd-ubi-tar"

OBMC_MACHINE_FEATURES += "\
        obmc-phosphor-fan-mgmt \
        obmc-phosphor-chassis-mgmt \
        obmc-phosphor-flash-mgmt \
        obmc-host-ipmi \
        obmc-host-state-mgmt \
        obmc-chassis-state-mgmt \
        obmc-bmc-state-mgmt \
        "

VIRTUAL-RUNTIME_obmc-host-state-manager = "x86-power-control"
VIRTUAL-RUNTIME_obmc-chassis-state-manager = "x86-power-control"
VIRTUAL-RUNTIME_obmc-discover-system-state = "x86-power-control"

PREFERRED_PROVIDER_virtual/obmc-chassis-mgmt = "packagegroup-gis-apps"
PREFERRED_PROVIDER_virtual/obmc-fan-mgmt = "packagegroup-gis-apps"
PREFERRED_PROVIDER_virtual/obmc-flash-mgmt = "packagegroup-gis-apps"
PREFERRED_PROVIDER_virtual/obmc-host-ipmi-hw = "phosphor-ipmi-kcs"
PREFERRED_PROVIDER_virtual/phosphor-led-manager-config-native = "gis-led-manager-config-native"
```

## meta-gsj/conf/layer.conf
```bitbake
# We have a conf and classes directory, add to BBPATH
BBPATH .= ":${LAYERDIR}"

# We have recipes-* directories, add to BBFILES
BBFILES += "${LAYERDIR}/recipes-*/*/*.bb \
            ${LAYERDIR}/recipes-*/*/*.bbappend"

BBFILE_COLLECTIONS += "gsj"
BBFILE_PATTERN_gsj = ""
LAYERSERIES_COMPAT_gsj = "thud"
```

## meta-runbmc-nuvoton/conf/machine/runbmc-nuvoton.conf
```bitbake
KMACHINE = "nuvoton"
KERNEL_DEVICETREE = "${KMACHINE}-npcm750-runbmc.dtb"

UBOOT_MACHINE = "PolegSVB_config"

FLASH_SIZE = "32768"
require conf/machine/include/npcm7xx.inc
require conf/machine/include/obmc-bsp-common.inc

IMAGE_FSTYPES += " cpio.${INITRAMFS_CTYPE}.u-boot"
IMAGE_FSTYPES += " mtd-ubi-tar"

OBMC_MACHINE_FEATURES += "\
        obmc-phosphor-fan-mgmt \
        obmc-phosphor-chassis-mgmt \
        obmc-phosphor-flash-mgmt \
        obmc-host-ipmi \
        obmc-host-state-mgmt \
        obmc-chassis-state-mgmt \
        obmc-bmc-state-mgmt \
        "

PREFERRED_PROVIDER_virtual/obmc-chassis-mgmt = "packagegroup-runbmc-apps"
PREFERRED_PROVIDER_virtual/obmc-fan-mgmt = "packagegroup-runbmc-apps"
PREFERRED_PROVIDER_virtual/obmc-flash-mgmt = "packagegroup-runbmc-apps"
PREFERRED_PROVIDER_virtual/obmc-system-mgmt = "packagegroup-runbmc-apps"
PREFERRED_PROVIDER_virtual/obmc-host-ipmi-hw = "phosphor-ipmi-kcs"
```
